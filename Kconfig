## Kconfig
```kconfig
config SENSORS_TMF8829
	tristate "ams-OSRAM TMF8829 TOF"
    	depends on I2C
	default n
 	help
	  If you say yes here you get support for the  tmf8829 sensor.
​
	  This driver can also be built as a module.  If so, the module
	  will be called tmf8829.ko.
```
